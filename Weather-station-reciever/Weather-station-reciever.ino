#include <WiFi.h>
#include <HTTPClient.h>
#include <ArduinoJson.h>
#include <Wire.h>
#include <Adafruit_SSD1306.h>
#include <Adafruit_GFX.h>

const char* ssid = "";
const char* password = "";
unsigned long lastFetchTime = 300000;
const unsigned long fetchInterval = 150000; // 2.5 min (in milliseconds)

float humidity;
float temperature;
float lux;
String timeString;

#define SCREEN_WIDTH 128 // OLED display width, in pixels
#define SCREEN_HEIGHT 64 // OLED display height, in pixels
 
//Declaration for an SSD1306 display connected to I2C (SDA, SCL pins)
Adafruit_SSD1306 display(SCREEN_WIDTH, SCREEN_HEIGHT, &Wire, -1);

#define LED_BT_BLUE 2  // Internal LED (or LED on the pin D2) for the connection indication (connected LED ON / disconnected LED OFF)
#define LED_BT_RED 15  // LED (LED on the pin D4) for the connection indication (connected LED OFF / disconnected LED ON)

// 'Blog_Parrot-Neonate-Care_Temp-and-humidity', 128x64px
const unsigned char myBitmap [] PROGMEM = {
  0x00, 0x01, 0x80, 0x00, 0x00, 0x00, 0x00, 0x00, 0x00, 0x00, 0x00, 0x00, 0x00, 0x00, 0x00, 0x00, 
  0x00, 0x07, 0xe0, 0x00, 0x00, 0x00, 0x00, 0x00, 0x00, 0x00, 0x00, 0x00, 0x00, 0x00, 0x00, 0x00, 
  0x00, 0x0c, 0x20, 0x00, 0x00, 0x00, 0x00, 0x00, 0x00, 0x00, 0x00, 0x00, 0x00, 0x00, 0x00, 0x00, 
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  0x00, 0x00, 0x00, 0x00, 0x1f, 0x80, 0x00, 0x00, 0x00, 0x00, 0x00, 0x00, 0x00, 0x00, 0x00, 0x00
};

void setup() {
  Serial.begin(115200);

  pinMode(LED_BT_BLUE, OUTPUT);
  pinMode(LED_BT_RED, OUTPUT);
  digitalWrite(LED_BT_BLUE, LOW);
  digitalWrite(LED_BT_RED, HIGH); 

  connectToWiFi();

 //OLED display setup
  // SSD1306_SWITCHCAPVCC = generate display voltage from 3.3V internally
  if(!display.begin(SSD1306_SWITCHCAPVCC, 0x3C)) { // Address 0x3C for 128x32
    Serial.println(F("SSD1306 allocation failed"));
    for(;;); // Don't proceed, loop forever
  }
  display.clearDisplay();
  display.setTextSize(2);
  display.setTextColor(WHITE,0);
  display.setCursor(0,25);
  display.print("WS Client");
  display.display();
}

void connectToWiFi() {
  Serial.println("Connecting to Wi-Fi...");
  WiFi.begin(ssid, password);
  while (WiFi.status() != WL_CONNECTED) {
    delay(1000);
    Serial.println("Connecting to WiFi...");
  }
  digitalWrite(LED_BT_RED, LOW);   
  Serial.println("Connected to Wi-Fi");
}

void fetchWeatherData() {
  HTTPClient http;
  String url = "https://whub.duckdns.org/api/weather/?id=&ordering=-id&time__time=&time__time__gte=&time__time__lte=&user=5&weather_station=4&limit=1";

  http.begin(url);
  digitalWrite(LED_BT_BLUE, HIGH);

  int httpResponseCode = http.GET();

  if (httpResponseCode > 0) {
    // Create a JSON stream
    DynamicJsonDocument doc(1024); // Adjust the buffer size as needed

    DeserializationError error = deserializeJson(doc, http.getStream());

    if (!error) {
      JsonObject result = doc["results"][0];
      const char* timeDate = result["time"];
      humidity = result["data"]["humidity"];
      temperature = result["data"]["temperature"];
      lux = result["data"]["light_intensity"];

      // Find the position of the 'T' character in the timestamp
      const char* timeStart = strchr(timeDate, 'T');

      // Move the pointer one position ahead to start with the time part
      timeStart++;
      
       // Extract only the hours and minutes part, which is 5 characters long (HH:MM)
       char time[6];
       strncpy(time, timeStart, 5);
       time[5] = '\0'; // Null-terminate the string 
       timeString = String(time);

      digitalWrite(LED_BT_BLUE, LOW);
      digitalWrite(LED_BT_RED, LOW); 
    } else {
      digitalWrite(LED_BT_RED, HIGH); 
      Serial.print("JSON parsing failed: ");
      Serial.println(error.c_str());
    }

    http.end();
  } else {
    digitalWrite(LED_BT_RED, HIGH); 
    Serial.print("Error fetching weather data. HTTP error code: ");
    Serial.println(httpResponseCode);
  }
}

void loop() {
  unsigned long currentTime = millis();

  if (currentTime - lastFetchTime >= fetchInterval) {
    fetchWeatherData();
    lastFetchTime = currentTime;
  }

  //clear display
  display.clearDisplay();

  // display temperature
  display.setTextSize(1);
  display.setCursor(60,0);
  display.print("Temperature ");
  display.setTextSize(2);
  display.setCursor(60,10);
  display.print(temperature);
  
  // display humidity
  display.setTextSize(1);
  display.setCursor(60, 35);
  display.print("Humidity ");
  display.setTextSize(2);
  display.setCursor(60, 45);
  display.print(humidity);
  
  display.drawBitmap(0, 0, myBitmap, 128, 64, WHITE);
  display.display(); 

  delay(5000);

  //clear display
  display.clearDisplay();

  //display lux 
  display.setTextSize(1);
  display.setCursor(0,0);
  display.print("Light intensity: ");
  display.setTextSize(2);
  display.setCursor(0, 10);
  display.print(lux);
  display.print("lux");

  //display Time measurement
  display.setTextSize(1);
  display.setCursor(0,35);
  display.print("Time measurement: ");
  display.setTextSize(2);
  display.setCursor(0, 45);
  display.print(timeString);
  display.display();
  delay(5000);
}
